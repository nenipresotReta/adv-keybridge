## Kconfig
```kconfig
config CARDPUTER_SD_LOG
    bool "Independent SD log writer"
    depends on FILE_SYSTEM && FAT_FILESYSTEM_ELM && LOG

config CARDPUTER_TCA8418
    bool "Cardputer ADV TCA8418 keyboard"
    default y
    depends on DT_HAS_M5STACK_ADV_TCA8418_ENABLED
    select I2C
    select GPIO
    select KSCAN

config CARDPUTER_UI
    bool "Cardputer ADV status display"
    default y
    depends on BOARD_CARDPUTER_ADV
    select DISPLAY
    select SPI
    select GPIO
    select ADC
    select PWM
    select ZMK_LOW_PRIORITY_WORK_QUEUE

config CARDPUTER_USB_HOST
    bool "External USB boot keyboard to ZMK Bluetooth"
    default y
    depends on BOARD_CARDPUTER_ADV

config CARDPUTER_LOG_CONSOLE
    bool "Read-only SD log export over shell"
    depends on CARDPUTER_SD_LOG && SHELL
```

## boards/m5stack/cardputer_adv/Kconfig.cardputer_adv
```kconfig
config BOARD_CARDPUTER_ADV
    select SOC_ESP32S3_WROOM_N8
    select SOC_ESP32S3_PROCPU
```

## boards/m5stack/cardputer_adv/board.yml
```yaml
board:
  name: cardputer_adv
  full_name: M5Stack Cardputer ADV
  vendor: m5stack
  socs:
    - name: esp32s3
```

## dts/bindings/behaviors/zmk,behavior-adv-page.yaml
```yaml
description: ADV local page action
compatible: "zmk,behavior-adv-page"
include: one_param.yaml
```

## dts/bindings/behaviors/zmk,behavior-adv-screen.yaml
```yaml
description: Cardputer ADV local settings navigation and screen commands
compatible: "zmk,behavior-adv-screen"
include: one_param.yaml
```

## dts/bindings/behaviors/zmk,behavior-usb-host.yaml
```yaml
description: Toggle Cardputer USB keyboard host mode
compatible: "zmk,behavior-usb-host"
include: zero_param.yaml
```

## dts/bindings/kscan/m5stack,adv-tca8418.yaml
```yaml
description: Cardputer ADV 7x8 TCA8418 mapped to its physical 4x14 keyboard
compatible: "m5stack,adv-tca8418"
include: i2c-device.yaml
properties:
  irq-gpios:
    type: phandle-array
    required: true
  poll-interval-ms:
    type: int
    default: 10
```

## dts/bindings/misc/m5stack,adv-battery.yaml
```yaml
description: Cardputer ADV battery voltage sense (100k/100k divider)
compatible: "m5stack,adv-battery"
include: base.yaml
properties:
  io-channels:
    type: phandle-array
    required: true
    description: Battery divider output, GPIO10 (ADC1 channel 9)
```

## dts/bindings/misc/m5stack,adv-controls.yaml
```yaml
description: Cardputer ADV PWM backlight and G0 menu button
compatible: "m5stack,adv-controls"
properties:
  menu-gpios:
    type: phandle-array
    required: true
  pwms:
    type: phandle-array
    required: true
```

## west.yml
```yaml
manifest:
  projects:
    - name: fatfs
      url: https://github.com/zephyrproject-rtos/fatfs
      revision: 16245c7c41d2b79e74984f49b5202551786b8a9b
      path: modules/fs/fatfs
      clone-depth: 1
    - name: tinyusb
      url: https://github.com/hathach/tinyusb
      revision: dae3f9a366bfcddbf9dcf1b48d7500286a849539 # TinyUSB 0.21.0
      path: modules/lib/tinyusb
      clone-depth: 1
    - name: zmk
      url: https://github.com/zmkfirmware/zmk
      revision: 4dd95d7840eb3d5a3f59bb29fbf1ab054715ef85
      clone-depth: 1
    - name: zephyr
      url: https://github.com/zmkfirmware/zephyr
      revision: 10ba6d0cb38bc3d258775d27982f707599320085
      clone-depth: 1
      west-commands: scripts/west-commands.yml
    - name: hal_espressif
      url: https://github.com/zephyrproject-rtos/hal_espressif
      revision: 8502aafa3856b9de1e530ccc3ce36e19978f58d2
      path: modules/hal/espressif
      clone-depth: 1
      west-commands: west/west-commands.yml
    - name: hal_xtensa
      url: https://github.com/zephyrproject-rtos/hal_xtensa
      revision: baa56aa3e119b5aae43d16f9b2d2c8112e052871
      path: modules/hal/xtensa
      clone-depth: 1
    - name: tinycrypt
      url: https://github.com/zephyrproject-rtos/tinycrypt
      revision: 1012a3ebee18c15ede5efc8332ee2fc37817670f
      path: modules/crypto/tinycrypt
      clone-depth: 1
    - name: mbedtls
      url: https://github.com/zephyrproject-rtos/mbedtls
      revision: 4952e1328529ee549d412b498ea71c54f30aa3b1
      path: modules/crypto/mbedtls
      clone-depth: 1
    - name: lvgl
      url: https://github.com/zmkfirmware/lvgl
      revision: f1db87ee98f1810328a8419572fa42a3b5f352ae
      path: modules/lib/gui/lvgl
      clone-depth: 1
  self:
    path: cardputer-zmk
```
